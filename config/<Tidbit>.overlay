&i2c0 {
    status = "okay";
    oled: ssd1306@3c {
        compatible = "solomon,ssd1306";
        reg = <0x3c>;
        label = "DISPLAY";
        height = <32>;
        width = <128>;
        segment-offset = <0>;
        page-offset = <0>;
        display-offset = <0>;
    };
};
